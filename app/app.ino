#include <WiFi.h>
#include <HTTPClient.h>
#include <ArduinoJson.h>

const char* ssid = "ASUS_2.4G";
const char* password =  "wifi1andar";

//PIN assignment
#define PIN_SCE 15
#define PIN_RESET 2
#define PIN_DC 4
#define PIN_SDIN 16
#define PIN_SCLK 17
#define LCD_COMMAND 0
#define LCD_DATA 1

//Setting the screen size (84x48 pixels)
#define LCD_X 84
#define LCD_Y 48

//Hexadecimal values for pixel assignment of characters and letters
static const byte ASCII[][5] = {
{0x00, 0x00, 0x00, 0x00, 0x00}, // 20 ,
{0x00, 0x00, 0x5f, 0x00, 0x00}, // 21 ! ,
{0x00, 0x07, 0x00, 0x07, 0x00}, // 22 " ,
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{0x78, 0x46, 0x41, 0x46, 0x78}, // 7f DEL
};

void positionXY(int x, int y) {
  LCDWrite(0, 0x80 | x);
  LCDWrite(0, 0x40 | y);
}

void LCDCharacter(char character) {
  LCDWrite(LCD_DATA, 0x00);
  for (int index = 0 ; index < 5 ; index++)
  {
    LCDWrite(LCD_DATA, ASCII[character - 0x20][index]);
  }
  LCDWrite(LCD_DATA, 0x00);
}

void LCDString(char *characters) {
  while (*characters)
  {
    LCDCharacter(*characters++);
  }
}

void LCDClear() {
  for (int index = 0 ; index < (LCD_X * LCD_Y / 8) ; index++)
  {
    LCDWrite(LCD_DATA, 0x00);
  }
  positionXY(0, 0);
}

void LCDInit() {
  pinMode(PIN_SCE, OUTPUT);
  pinMode(PIN_RESET, OUTPUT);
  pinMode(PIN_DC, OUTPUT);
  pinMode(PIN_SDIN, OUTPUT);
  pinMode(PIN_SCLK, OUTPUT);
  digitalWrite(PIN_RESET, LOW);
  digitalWrite(PIN_RESET, HIGH);
  LCDWrite(LCD_COMMAND, 0x21);
  LCDWrite(LCD_COMMAND, 0xB0);
  LCDWrite(LCD_COMMAND, 0x04);
  LCDWrite(LCD_COMMAND, 0x14);
  LCDWrite(LCD_COMMAND, 0x20);
  LCDWrite(LCD_COMMAND, 0x0C);
}

void LCDWrite(byte data_or_command, byte data) {
  digitalWrite(PIN_DC, data_or_command);
  digitalWrite(PIN_SCE, LOW);
  shiftOut(PIN_SDIN, PIN_SCLK, MSBFIRST, data);
  digitalWrite(PIN_SCE, HIGH);
}

void fillEmpty(int n) {
  int nEmpty = 13 - n;
  for (int j = 0; j < nEmpty; j++) {
    LCDString(" ");
  }
}

void setup() {
  LCDInit();
  Serial.begin(115200);
  delay(4000);
  WiFi.begin(ssid, password);
  while (WiFi.status() != WL_CONNECTED) {
    delay(1000);
    Serial.println("Connecting to WiFi..");
  }
  Serial.println("Connected to the WiFi network");
}

String plonline;
int nEmpty;
int online;


void loop() {
  LCDClear();
  if ((WiFi.status() == WL_CONNECTED)) { //Check the current connection status
    HTTPClient http;
    http.begin("https://api.minetools.eu/ping/andrerpi4.ddns.net/25565"); //Specify the URL
    int httpCode = http.GET();                                        //Make the request
    if (httpCode > 0) { //Check for the returning code
      String payload = http.getString();
      //Serial.println(httpCode);
      DynamicJsonDocument doc(16384);
      auto error = deserializeJson(doc, payload);
      if (error) {
          Serial.print(F("deserializeJson() failed with code "));
          Serial.println(error.c_str());
          return;
      }

      String errorFetch = doc["error"];
      Serial.println(errorFetch);
      Serial.println(errorFetch.length());
      if (errorFetch.length() > 4) {
        LCDString("Server      Offline");
      } else {
        online = doc["players"]["online"];
        String str = "Online: ";
        plonline = str + online;
        //Serial.println(plonline);
        int n = plonline.length() + 1;
        char charArray[n + 1];
        plonline.toCharArray(charArray, n);
        LCDString(charArray);
        fillEmpty(n);
    
        //Print Player names
        for (int i = 0; i < online; i++) {
          String info = doc["players"]["sample"][i]["name"];
          n = info.length() + 1;
          charArray[n+1];
          info.toCharArray(charArray, n);
          LCDString(charArray);
          fillEmpty(n);
          
          Serial.println(info);
        }
      }
    } else {
      Serial.println("Error on HTTP request");
    }
    http.end(); //Free the resources
  }
  delay(20000);
}
